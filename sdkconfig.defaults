## sdkconfig.defaults
```kconfig
CONFIG_ESPTOOLPY_BEFORE_NORESET=y
CONFIG_ESPTOOLPY_AFTER_NORESET=y
CONFIG_TEMBED_INIT_LCD=y
CONFIG_TEMBED_INIT_LEDS=y
CONFIG_TEMBED_INIT_DIAL=y
CONFIG_LV_COLOR_16_SWAP=1
```
